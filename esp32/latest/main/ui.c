#include "ui.h"

#include <inttypes.h>
#include <stdio.h>
#include <stdlib.h>
#include <string.h>
#include <time.h>

#include "app_config.h"
#include "esp_log.h"
#include "esp_timer.h"
#include "freertos/FreeRTOS.h"
#include "freertos/queue.h"
#include "freertos/task.h"
#include "hardware.h"
#include "lcd_lvgl.h"
#include "lvgl.h"

LV_FONT_DECLARE(kvm_font_unscii_12);

/*
 * Windows 1992-2001 flying-flag mark, rasterized at 25 x 22 from the
 * standard 1080 x 934 SVG while preserving its original proportions.
 */
static const uint8_t s_windows95_icon_map[] = {
    0x00,0x00,0x00,0x00,0x00,0x00,0x00,0x00,0x00,0x00,0x00,0x00,0x00,0x00,0x00,0x00,0x00,0x00,0x00,0x0c,
    0x00,0x00,0x00,0x6e,0x00,0x00,0x00,0x00,0x00,0x00,0x00,0x00,0x00,0x00,0x00,0x00,0x00,0x00,0x00,0x00,
    0x00,0x00,0x00,0x00,0x00,0x00,0x00,0x00,0x00,0x00,0x00,0x00,0x00,0x00,0x00,0x00,0x00,0x00,0x00,0x00,
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    0x00,0x00,0x00,0x00,0x00,0x00,0x00,0x00,0x00,0x00,0x00,0x00,0x00,0x00,0x00,0x00,0x00,0x00,0x00,0x00,

};

static const lv_image_dsc_t s_windows95_icon = {
    .header.magic = LV_IMAGE_HEADER_MAGIC,
    .header.cf = LV_COLOR_FORMAT_ARGB8888,
    .header.flags = 0,
    .header.w = 25,
    .header.h = 22,
    .header.stride = 100,
    .data_size = sizeof(s_windows95_icon_map),
    .data = s_windows95_icon_map,
};

/*
 * 16 x 20 antialiased raster of the standard black Apple silhouette.
 * Source outline: Wikimedia Commons Apple_logo_black.svg (814 x 1000).
 */
static const uint8_t s_apple_black_icon_map[] = {
    0x00,0x00,0x00,0x00,0x00,0x00,0x00,0x00,0x00,0x00,0x40,0x63,0x01,0x00,0x00,0x00,
    0x00,0x00,0x00,0x00,0x00,0x00,0x00,0x00,0x05,0x92,0xff,0xa8,0x00,0x00,0x00,0x00,
    0x00,0x00,0x00,0x00,0x00,0x00,0x00,0x00,0x71,0xff,0xff,0x54,0x00,0x00,0x00,0x00,
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    0x00,0x00,0x00,0x00,0x57,0x9c,0x3d,0x04,0x00,0x0f,0x55,0x74,0x2d,0x00,0x00,0x00,
};

static const lv_image_dsc_t s_apple_black_icon = {
    .header.magic = LV_IMAGE_HEADER_MAGIC,
    .header.cf = LV_COLOR_FORMAT_A8,
    .header.flags = 0,
    .header.w = 16,
    .header.h = 20,
    .header.stride = 16,
    .data_size = sizeof(s_apple_black_icon_map),
    .data = s_apple_black_icon_map,
};

/* Five-blade computer cooling fan, rasterized to a 27 x 27 A8 pixel mask. */
static const uint8_t s_fan_icon_map[] = {
    0x00,0x00,0x00,0x00,0x00,0x00,0x00,0x00,0x00,0x00,0x00,0x00,0x00,0x00,0x00,0x00,0x00,0x00,0x00,0x00,0x00,0x00,0x00,0x00,0x00,0x00,0x00,
    0x00,0x00,0x00,0x00,0x00,0x00,0x00,0x00,0x00,0x00,0x00,0x00,0x00,0x00,0x00,0x00,0x00,0x00,0x00,0x00,0x00,0x00,0x00,0x00,0x00,0x00,0x00,
    0x00,0x00,0x00,0x00,0x00,0x00,0x00,0x00,0x00,0x00,0x00,0x00,0x00,0x00,0x00,0x00,0x00,0x00,0x00,0x00,0x00,0x00,0x00,0x00,0x00,0x00,0x00,
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    0x00,0x00,0x00,0x00,0x00,0x00,0x00,0x00,0x00,0x00,0x00,0x00,0x00,0x00,0x00,0x00,0x00,0x00,0x00,0x00,0x00,0x00,0x00,0x00,0x00,0x00,0x00,
};

static const lv_image_dsc_t s_fan_icon = {
    .header.magic = LV_IMAGE_HEADER_MAGIC,
    .header.cf = LV_COLOR_FORMAT_A8,
    .header.flags = 0,
    .header.w = 27,
    .header.h = 27,
    .header.stride = 27,
    .data_size = sizeof(s_fan_icon_map),
    .data = s_fan_icon_map,
};

extern const uint8_t boot_apple_rgb565_start[]
    asm("_binary_boot_apple_rgb565_start");

static const lv_image_dsc_t s_boot_apple = {
    .header.magic = LV_IMAGE_HEADER_MAGIC,
    .header.cf = LV_COLOR_FORMAT_RGB565,
    .header.flags = 0,
    .header.w = 96,
    .header.h = 112,
    .header.stride = 192,
    .data_size = 96 * 112 * 2,
    .data = boot_apple_rgb565_start,
};


typedef struct {
    lv_obj_t *lan;
    lv_obj_t *mac;
    lv_obj_t *windows;
    lv_obj_t *active_host;
    lv_obj_t *data_title;
    lv_obj_t *cpu;
    lv_obj_t *memory;
    lv_obj_t *memory_segments[20];
    lv_obj_t *cooler_level;
    lv_obj_t *cooler_mode;
    lv_obj_t *cooler_target;
    lv_obj_t *dashboard_title;
    lv_obj_t *dashboard_pages[3];
    lv_obj_t *health_mark;
    lv_obj_t *health_text;
    lv_obj_t *network;
    lv_obj_t *connections;
    lv_obj_t *error;
    lv_obj_t *weather_city;
    lv_obj_t *weather_temperature;
    lv_obj_t *weather_high_low;
    lv_obj_t *weather_current_icon;
    lv_obj_t *weather_daily_day[APP_WEATHER_DAILY_COUNT];
    lv_obj_t *weather_daily_value[APP_WEATHER_DAILY_COUNT];
    lv_obj_t *weather_daily_icon[APP_WEATHER_DAILY_COUNT];
    lv_obj_t *weather_hour[APP_WEATHER_HOURLY_COUNT];
    lv_obj_t *weather_hour_temperature[APP_WEATHER_HOURLY_COUNT];
    lv_obj_t *weather_hour_icon[APP_WEATHER_HOURLY_COUNT];
    lv_obj_t *market_price[3];
    lv_obj_t *market_change[3];
    lv_obj_t *clock;
} widgets_t;

typedef enum {
    UI_COMMAND_BOOT_STATUS = 0,
    UI_COMMAND_SHOW_MAIN,
} ui_command_type_t;

typedef struct {
    ui_command_type_t type;
    char text[40];
} ui_command_t;

static const char *TAG = "ui";
static app_state_t *s_state;
static TaskHandle_t s_task;
static QueueHandle_t s_commands;
static volatile bool s_ready;
static widgets_t s_widgets;
static lv_style_t s_panel_style;
static lv_style_t s_title_style;
static lv_style_t s_text_style;
static bool s_styles_initialized;

static void label_set_text_if_changed(lv_obj_t *label, const char *text)
{
    const char *current = lv_label_get_text(label);
    if (current == NULL || strcmp(current, text) != 0) {
        lv_label_set_text(label, text);
    }
}

static void set_text_color_if_changed(lv_obj_t *object, uint32_t color)
{
    const lv_color_t next = lv_color_hex(color);
    if (!lv_color_eq(lv_obj_get_style_text_color(object, LV_PART_MAIN), next)) {
        lv_obj_set_style_text_color(object, next, 0);
    }
}

static void set_bg_color_if_changed(lv_obj_t *object, uint32_t color)
{
    const lv_color_t next = lv_color_hex(color);
    if (!lv_color_eq(lv_obj_get_style_bg_color(object, LV_PART_MAIN), next)) {
        lv_obj_set_style_bg_color(object, next, 0);
    }
}

static lv_obj_t *pixel(lv_obj_t *parent, int x, int y, int width, int height,
                       uint32_t color)
{
    lv_obj_t *part = lv_obj_create(parent);
    lv_obj_remove_style_all(part);
    lv_obj_set_pos(part, x, y);
    lv_obj_set_size(part, width, height);
    lv_obj_set_style_bg_color(part, lv_color_hex(color), 0);
    lv_obj_set_style_bg_opa(part, LV_OPA_COVER, 0);
    lv_obj_clear_flag(part, LV_OBJ_FLAG_SCROLLABLE);
    return part;
}

static void create_rainbow_apple(lv_obj_t *parent, int x, int y)
{
    /* Fine 1 px rows keep the classic rainbow silhouette legible at 20 px. */
    pixel(parent, x + 12, y,      4, 1, 0x55a447);
    pixel(parent, x + 10, y + 1,  6, 1, 0x55a447);
    pixel(parent, x + 9,  y + 2,  6, 1, 0x55a447);
    pixel(parent, x + 9,  y + 3,  4, 1, 0x55a447);
    pixel(parent, x + 5,  y + 4, 11, 1, 0x55a447);
    pixel(parent, x + 3,  y + 5, 15, 1, 0x55a447);
    pixel(parent, x + 2,  y + 6, 17, 1, 0x55a447);
    pixel(parent, x + 2,  y + 7, 15, 1, 0xe5c43f);
    pixel(parent, x + 1,  y + 8, 15, 1, 0xe5c43f);
    pixel(parent, x + 1,  y + 9, 14, 1, 0xed8a31);
    pixel(parent, x + 1,  y + 10, 14, 1, 0xed8a31);
    pixel(parent, x + 1,  y + 11, 15, 1, 0xd94a4a);
    pixel(parent, x + 1,  y + 12, 16, 1, 0xd94a4a);
    pixel(parent, x + 2,  y + 13, 16, 1, 0x8e5aa9);
    pixel(parent, x + 2,  y + 14, 17, 1, 0x8e5aa9);
    pixel(parent, x + 3,  y + 15, 15, 1, 0x3d85c6);
    pixel(parent, x + 4,  y + 16, 13, 1, 0x3d85c6);
    pixel(parent, x + 5,  y + 17,  5, 1, 0x3d85c6);
    pixel(parent, x + 12, y + 17,  4, 1, 0x3d85c6);
}

static lv_obj_t *create_lan_icon(lv_obj_t *parent, int x, int y)
{
    lv_obj_t *icon = lv_label_create(parent);
    lv_obj_remove_style_all(icon);
    lv_obj_set_pos(icon, x, y);
    lv_obj_set_size(icon, 22, 20);
    lv_obj_set_style_text_font(icon, &lv_font_montserrat_16, 0);
    lv_obj_set_style_text_color(icon, lv_color_hex(0x34373b), 0);
    lv_obj_set_style_text_align(icon, LV_TEXT_ALIGN_CENTER, 0);
    lv_label_set_text(icon, LV_SYMBOL_WIFI);
    return icon;
}

static lv_obj_t *create_mac_icon(lv_obj_t *parent, int x, int y)
{
    lv_obj_t *icon = lv_image_create(parent);
    lv_image_set_src(icon, &s_apple_black_icon);
    lv_obj_set_pos(icon, x, y);
    lv_obj_set_style_image_recolor(icon, lv_color_hex(0x111111), 0);
    lv_obj_set_style_image_recolor_opa(icon, LV_OPA_COVER, 0);
    return icon;
}

static lv_obj_t *create_windows_icon(lv_obj_t *parent, int x, int y)
{
    lv_obj_t *icon = lv_image_create(parent);
    lv_image_set_src(icon, &s_windows95_icon);
    lv_obj_set_pos(icon, x, y);
    return icon;
}

static void set_icon_online_state(lv_obj_t *icon, bool online)
{
    const lv_opa_t opacity = online ? LV_OPA_COVER : LV_OPA_40;
    if (lv_obj_get_style_opa(icon, LV_PART_MAIN) != opacity) {
        lv_obj_set_style_opa(icon, opacity, 0);
    }
}

static uint32_t tick_ms(void)
{
    return (uint32_t)(esp_timer_get_time() / 1000);
}

static lv_obj_t *label_at(lv_obj_t *parent, int x, int y, int width, const char *text)
{
    lv_obj_t *label = lv_label_create(parent);
    lv_obj_add_style(label, &s_text_style, 0);
    lv_obj_set_pos(label, x, y);
    lv_obj_set_width(label, width);
    lv_label_set_long_mode(label, LV_LABEL_LONG_CLIP);
    lv_label_set_text(label, text);
    return label;
}

static lv_obj_t *panel(lv_obj_t *screen, int x, int y, int width, int height,
                       const char *title)
{
    lv_obj_t *body = lv_obj_create(screen);
    lv_obj_add_style(body, &s_panel_style, 0);
    lv_obj_set_pos(body, x, y);
    lv_obj_set_size(body, width, height);
    lv_obj_clear_flag(body, LV_OBJ_FLAG_SCROLLABLE);

    lv_obj_t *bar = lv_obj_create(body);
    lv_obj_add_style(bar, &s_title_style, 0);
    lv_obj_set_pos(bar, 0, 0);
    lv_obj_set_size(bar, width - 4, 17);
    lv_obj_clear_flag(bar, LV_OBJ_FLAG_SCROLLABLE);
    lv_obj_t *caption = label_at(bar, 0, 2, width - 4, title);
    lv_obj_set_style_text_align(caption, LV_TEXT_ALIGN_CENTER, 0);
    return body;
}

static void create_fan_icon(lv_obj_t *parent, int x, int y)
{
    lv_obj_t *fan = lv_image_create(parent);
    lv_image_set_src(fan, &s_fan_icon);
    /*
     * x/y 是 27x27 原始图片框的左上角，不是黑色风扇的可见边缘。
     * 素材四周带透明留白，384 表示以图片中心为轴放大到 1.5 倍，
     * 所以屏幕上真正看到的边缘会超出这里设置的 x/y 图片框。
     */
    lv_obj_set_pos(fan, x, y);
    lv_obj_set_style_transform_scale(fan, 384, 0);
    lv_obj_set_style_image_recolor(fan, lv_color_hex(0x34373b), 0);
    lv_obj_set_style_image_recolor_opa(fan, LV_OPA_COVER, 0);
}

static void create_degree_mark(lv_obj_t *parent, int x, int y, int scale)
{
    const uint32_t ink = 0x111111;
    pixel(parent, x + scale, y, scale * 2, scale, ink);
    pixel(parent, x, y + scale, scale, scale * 2, ink);
    pixel(parent, x + scale * 3, y + scale, scale, scale * 2, ink);
    pixel(parent, x + scale, y + scale * 3, scale * 2, scale, ink);
}

typedef enum { WEATHER_SUN, WEATHER_CLOUD, WEATHER_RAIN, WEATHER_SNOW,
               WEATHER_THUNDER, WEATHER_FOG } weather_icon_kind_t;

static weather_icon_kind_t weather_icon_kind(uint16_t code)
{
    if ((code >= 300 && code <= 399) || (code >= 51 && code <= 82)) {
        return code == 302 || code == 303 || code == 304 ? WEATHER_THUNDER : WEATHER_RAIN;
    }
    if ((code >= 400 && code <= 499) || (code >= 71 && code <= 86)) return WEATHER_SNOW;
    if ((code >= 500 && code <= 515) || (code >= 45 && code <= 48)) return WEATHER_FOG;
    if (code >= 95 && code <= 99) return WEATHER_THUNDER;
    if ((code >= 101 && code <= 104) || code == 2 || code == 3) return WEATHER_CLOUD;
    return WEATHER_SUN;
}

static void draw_weather_icon(lv_obj_t *holder, uint16_t code, bool is_day)
{
    lv_obj_clean(holder);
    const int size = lv_obj_get_width(holder);
    const int s = size >= 22 ? 3 : 2;
    const weather_icon_kind_t kind = weather_icon_kind(code);
    if (kind == WEATHER_SUN) {
        const uint32_t color = is_day ? 0xf0b429 : 0x5a68a5;
        pixel(holder, 2*s, 1*s, 3*s, 1*s, color);
        pixel(holder, 1*s, 2*s, 5*s, 3*s, color);
        pixel(holder, 2*s, 5*s, 3*s, 1*s, color);
        return;
    }
    if (kind == WEATHER_THUNDER) {
        pixel(holder, 1*s, 1*s, 5*s, 3*s, 0x778899);
        pixel(holder, 3*s, 4*s, 2*s, 1*s, 0xf0b429);
        pixel(holder, 2*s, 5*s, 2*s, 2*s, 0xf0b429);
        return;
    }
    if (kind == WEATHER_FOG) {
        pixel(holder, 1*s, 2*s, 5*s, 1*s, 0x9aa3a8);
        pixel(holder, 2*s, 4*s, 5*s, 1*s, 0x9aa3a8);
        pixel(holder, 1*s, 6*s, 4*s, 1*s, 0x9aa3a8);
        return;
    }
    pixel(holder, 1*s, 1*s, 4*s, 1*s, 0x7c93a5);
    pixel(holder, 0*s, 2*s, 6*s, 2*s, 0x7c93a5);
    if (kind == WEATHER_CLOUD) return;
    const uint32_t drop = kind == WEATHER_SNOW ? 0xb9d9ef : 0x2e86c1;
    pixel(holder, 1*s, 5*s, 1*s, 1*s, drop);
    pixel(holder, 3*s, 4*s, 1*s, 1*s, drop);
    pixel(holder, 5*s, 5*s, 1*s, 1*s, drop);
}

static lv_obj_t *icon_holder(lv_obj_t *parent, int x, int y, int size)
{
    lv_obj_t *holder = lv_obj_create(parent);
    lv_obj_remove_style_all(holder);
    lv_obj_set_pos(holder, x, y);
    lv_obj_set_size(holder, size, size);
    lv_obj_clear_flag(holder, LV_OBJ_FLAG_SCROLLABLE);
    return holder;
}

static const char *phase_text(kvm_phase_t phase)
{
    switch (phase) {
        case KVM_IDLE: return "READY";
        case KVM_DISABLED_UNCONFIRMED_TIMING: return "LOCKED";
        case KVM_SENDING_DDC: return "SENDING";
        case KVM_WAITING_DDC_RESULT: return "DDC WAIT";
        case KVM_WAITING_DISPLAY: return "DISPLAY";
        case KVM_PULSING_USB: return "USB";
        case KVM_COOLING: return "COOLING";
        case KVM_ERROR: return "ERROR";
        default: return "UNKNOWN";
    }
}

static void init_styles(void)
{
    if (s_styles_initialized) return;
    lv_style_init(&s_text_style);
    lv_style_set_text_font(&s_text_style, &lv_font_unscii_8);
    lv_style_set_text_color(&s_text_style, lv_color_hex(0x111111));
    lv_style_set_pad_all(&s_text_style, 0);

    lv_style_init(&s_panel_style);
    lv_style_set_bg_color(&s_panel_style, lv_color_hex(0xffffff));
    lv_style_set_bg_opa(&s_panel_style, LV_OPA_COVER);
    lv_style_set_border_color(&s_panel_style, lv_color_hex(0x111111));
    lv_style_set_border_width(&s_panel_style, 2);
    lv_style_set_radius(&s_panel_style, 0);
    lv_style_set_pad_all(&s_panel_style, 1);
    lv_style_set_shadow_color(&s_panel_style, lv_color_hex(0x111111));
    lv_style_set_shadow_width(&s_panel_style, 0);
    lv_style_set_shadow_offset_x(&s_panel_style, 2);
    lv_style_set_shadow_offset_y(&s_panel_style, 2);
    lv_style_set_shadow_opa(&s_panel_style, LV_OPA_COVER);

    lv_style_init(&s_title_style);
    lv_style_set_bg_color(&s_title_style, lv_color_hex(0xd7d7d3));
    lv_style_set_bg_opa(&s_title_style, LV_OPA_COVER);
    lv_style_set_border_color(&s_title_style, lv_color_hex(0x111111));
    lv_style_set_border_width(&s_title_style, 0);
    lv_style_set_border_side(&s_title_style, LV_BORDER_SIDE_BOTTOM);
    lv_style_set_radius(&s_title_style, 0);
    lv_style_set_pad_all(&s_title_style, 0);
    s_styles_initialized = true;
}

static void create_boot_apple(lv_obj_t *parent)
{
    lv_obj_t *logo = lv_image_create(parent);
    lv_image_set_src(logo, &s_boot_apple);
    lv_obj_set_pos(logo, (APP_LCD_WIDTH - 96) / 2, 34);
}

static lv_obj_t *create_boot_screen(void)
{
    init_styles();
    lv_obj_t *screen = lv_screen_active();
    lv_obj_clean(screen);
    lv_obj_set_style_bg_color(screen, lv_color_hex(0xffffff), 0);
    lv_obj_set_style_bg_opa(screen, LV_OPA_COVER, 0);
    lv_obj_clear_flag(screen, LV_OBJ_FLAG_SCROLLABLE);
    create_boot_apple(screen);
    lv_obj_t *status = label_at(screen, 0, 170, APP_LCD_WIDTH, "INITIALIZING DISPLAY");
    lv_obj_set_style_text_align(status, LV_TEXT_ALIGN_CENTER, 0);
    return status;
}

static void create_screen(void)
{
    init_styles();

    lv_obj_t *screen = lv_screen_active();
    lv_obj_clean(screen);
    lv_obj_set_style_bg_color(screen, lv_color_hex(0xbdbdb8), 0);
    lv_obj_set_style_bg_opa(screen, LV_OPA_COVER, 0);
    lv_obj_clear_flag(screen, LV_OBJ_FLAG_SCROLLABLE);

    lv_obj_t *menu = lv_obj_create(screen);
    lv_obj_add_style(menu, &s_panel_style, 0);
    lv_obj_set_pos(menu, 8, 1);
    lv_obj_set_size(menu, 304, 28);
    lv_obj_set_style_shadow_opa(menu, LV_OPA_TRANSP, 0);
    lv_obj_clear_flag(menu, LV_OBJ_FLAG_SCROLLABLE);
    create_rainbow_apple(menu, 5, 2);
    s_widgets.active_host = label_at(menu, 36, 7, 30, "MAC");
    s_widgets.lan = create_lan_icon(menu, 219, 2);
    s_widgets.mac = create_mac_icon(menu, 248, 1);
    s_widgets.windows = create_windows_icon(menu, 272, 1);

    lv_obj_t *data = panel(screen, 8, 36, 198, 78, "LIVE DATA");
    lv_obj_t *data_bar = lv_obj_get_child(data, 0);
    s_widgets.data_title = lv_obj_get_child(data_bar, 0);
    label_at(data, 10, 20, 96, "CPU TEMP");
    label_at(data, 116, 20, 70, "MEMORY");
    s_widgets.cpu = label_at(data, 9, 33, 31, "--");
    lv_obj_set_style_text_font(s_widgets.cpu, &lv_font_unscii_16, 0);
    lv_obj_set_style_text_align(s_widgets.cpu, LV_TEXT_ALIGN_RIGHT, 0);
    create_degree_mark(data, 42, 35, 1);
    lv_obj_t *cpu_unit = label_at(data, 49, 33, 12, "C");
    lv_obj_set_style_text_font(cpu_unit, &lv_font_unscii_16, 0);
    s_widgets.memory = label_at(data, 113, 33, 70, "--%");
    lv_obj_set_style_text_font(s_widgets.memory, &lv_font_unscii_16, 0);
    lv_obj_t *memory_frame = lv_obj_create(data);
    lv_obj_remove_style_all(memory_frame);
    lv_obj_set_pos(memory_frame, 4, 55);
    lv_obj_set_size(memory_frame, 184, 13);
    lv_obj_set_style_bg_color(memory_frame, lv_color_hex(0xffffff), 0);
    lv_obj_set_style_bg_opa(memory_frame, LV_OPA_COVER, 0);
    lv_obj_set_style_border_color(memory_frame, lv_color_hex(0x111111), 0);
    lv_obj_set_style_border_width(memory_frame, 2, 0);
    lv_obj_set_style_radius(memory_frame, 0, 0);
    lv_obj_clear_flag(memory_frame, LV_OBJ_FLAG_SCROLLABLE);
    for (int i = 0; i < 20; ++i) {
        lv_obj_t *segment = lv_obj_create(memory_frame);
        lv_obj_remove_style_all(segment);
        lv_obj_set_pos(segment, 1 + i * 9, 1);
        lv_obj_set_size(segment, 7, 7);
        lv_obj_set_style_bg_color(segment, lv_color_hex(0xffffff), 0);
        lv_obj_set_style_bg_opa(segment, LV_OPA_COVER, 0);
        lv_obj_set_style_radius(segment, 0, 0);
        lv_obj_clear_flag(segment, LV_OBJ_FLAG_SCROLLABLE);
        s_widgets.memory_segments[i] = segment;
    }

    /*
     * COOLING 排版参数（全部是相对本区块左上角的坐标）：
     * - panel(..., 215, 36, 97, 78)：区块在屏幕上的 x、y、宽、高。
     * - create_fan_icon(..., 4, 20)：风扇原始图片框的 x、y。
     * - cooler_level(..., 46, 18, 32)：档位文字的 x、y、裁切宽度。
     * - cooler_target(..., 46, 38, 25)：温度数字的 x、y、裁切宽度。
     * - degree/C 的 x、y：温度单位的位置。
     * 数值 x 减小会左移，y 减小会上移；档位和温度的 x 都是 46，
     * 因此文字对象左边线相同。视觉边缘仍会受到具体字形留白影响。
     */
    lv_obj_t *cooling = panel(screen, 215, 36, 97, 78, "COOLING");
    create_fan_icon(cooling, 3, 19);
    s_widgets.cooler_level = label_at(cooling, 46, 24, 32, "-");
    lv_obj_set_style_text_font(s_widgets.cooler_level, &kvm_font_unscii_12, 0);
    lv_obj_set_style_text_align(s_widgets.cooler_level, LV_TEXT_ALIGN_LEFT, 0);
    s_widgets.cooler_target = label_at(cooling, 46, 42, 25, "--");
    lv_obj_set_style_text_font(s_widgets.cooler_target, &kvm_font_unscii_12, 0);
    lv_obj_set_style_text_align(s_widgets.cooler_target, LV_TEXT_ALIGN_LEFT, 0);
    create_degree_mark(cooling, 73, 40, 1);
    label_at(cooling, 78, 45, 7, "C");
    s_widgets.cooler_mode = label_at(cooling, 6, 60, 83, "MANUAL");
    lv_obj_set_style_text_align(s_widgets.cooler_mode, LV_TEXT_ALIGN_CENTER, 0);

    lv_obj_t *kvm = panel(screen, 8, 122, 304, 84, "SYSTEM");
    lv_obj_t *kvm_bar = lv_obj_get_child(kvm, 0);
    s_widgets.dashboard_title = lv_obj_get_child(kvm_bar, 0);
    for (int i = 0; i < 3; ++i) {
        s_widgets.dashboard_pages[i] = lv_obj_create(kvm);
        lv_obj_remove_style_all(s_widgets.dashboard_pages[i]);
        lv_obj_set_pos(s_widgets.dashboard_pages[i], 1, 17);
        lv_obj_set_size(s_widgets.dashboard_pages[i], 298, 63);
        lv_obj_clear_flag(s_widgets.dashboard_pages[i], LV_OBJ_FLAG_SCROLLABLE);
    }
    lv_obj_t *system_page = s_widgets.dashboard_pages[0];
    s_widgets.health_mark = label_at(system_page, 7, 4, 26, "!");
    lv_obj_set_style_text_font(s_widgets.health_mark, &lv_font_unscii_16, 0);
    lv_obj_set_style_text_align(s_widgets.health_mark, LV_TEXT_ALIGN_CENTER, 0);
    s_widgets.health_text = label_at(system_page, 37, 7, 88, "STARTING");
    s_widgets.network = label_at(system_page, 131, 7, 160, "IP 0.0.0.0");
    lv_obj_set_style_text_align(s_widgets.network, LV_TEXT_ALIGN_RIGHT, 0);
    s_widgets.connections = label_at(system_page, 7, 26, 284, "SOURCE --");
    s_widgets.error = label_at(system_page, 7, 42, 284, "NO ERRORS");

    lv_obj_t *weather_page = s_widgets.dashboard_pages[1];
    s_widgets.weather_city = label_at(weather_page, 3, 1, 102, "NO WEATHER");
    s_widgets.weather_current_icon = icon_holder(weather_page, 3, 12, 24);
    s_widgets.weather_temperature = label_at(weather_page, 31, 13, 34, "--");
    lv_obj_set_style_text_font(s_widgets.weather_temperature, &lv_font_unscii_16, 0);
    s_widgets.weather_high_low = label_at(weather_page, 65, 17, 40, "--/--");
    for (int i = 0; i < APP_WEATHER_DAILY_COUNT; ++i) {
        const int x = 3 + i * 35;
        s_widgets.weather_daily_day[i] = label_at(weather_page, x, 40, 31, "---");
        s_widgets.weather_daily_icon[i] = icon_holder(weather_page, x, 49, 12);
        s_widgets.weather_daily_value[i] = label_at(weather_page, x + 13, 50, 22, "--");
    }
    pixel(weather_page, 108, 2, 1, 57, 0x111111);
    for (int i = 0; i < APP_WEATHER_HOURLY_COUNT; ++i) {
        const int x = 114 + i * 36;
        s_widgets.weather_hour[i] = label_at(weather_page, x, 2, 32, "--");
        lv_obj_set_style_text_align(s_widgets.weather_hour[i], LV_TEXT_ALIGN_CENTER, 0);
        s_widgets.weather_hour_icon[i] = icon_holder(weather_page, x + 8, 14, 16);
        s_widgets.weather_hour_temperature[i] = label_at(weather_page, x, 34, 32, "--");
        lv_obj_set_style_text_align(s_widgets.weather_hour_temperature[i], LV_TEXT_ALIGN_CENTER, 0);
    }

    lv_obj_t *market_page = s_widgets.dashboard_pages[2];
    static const char *symbols[] = { "BTC/USDT", "DOGE/USDT", "USD/CNY" };
    for (int i = 0; i < 3; ++i) {
        const int y = 5 + i * 19;
        label_at(market_page, 8, y, 70, symbols[i]);
        s_widgets.market_price[i] = label_at(market_page, 82, y, 130, "--");
        lv_obj_set_style_text_align(s_widgets.market_price[i], LV_TEXT_ALIGN_RIGHT, 0);
        s_widgets.market_change[i] = label_at(market_page, 220, y, 70, "--");
        lv_obj_set_style_text_align(s_widgets.market_change[i], LV_TEXT_ALIGN_RIGHT, 0);
    }

    lv_obj_t *status = lv_obj_create(screen);
    lv_obj_add_style(status, &s_panel_style, 0);
    lv_obj_set_pos(status, 8, 210);
    lv_obj_set_size(status, 304, 23);
    lv_obj_set_style_shadow_opa(status, LV_OPA_TRANSP, 0);
    lv_obj_clear_flag(status, LV_OBJ_FLAG_SCROLLABLE);
    lv_obj_t *version = label_at(status, 3, 0, 100, APP_VERSION);
    lv_obj_set_style_text_font(version, &lv_font_unscii_8, 0);
    lv_obj_align(version, LV_ALIGN_LEFT_MID, 3, 0);
    /* 宽度固定为 64；LV_ALIGN_CENTER 同时负责底栏内左右和上下居中。 */
    s_widgets.clock = label_at(status, 0, 0, 64, "--:--");
    lv_obj_set_style_text_font(s_widgets.clock, &lv_font_unscii_8, 0);
    lv_obj_set_style_text_color(s_widgets.clock, lv_color_hex(0x111111), 0);
    lv_obj_set_style_text_align(s_widgets.clock, LV_TEXT_ALIGN_CENTER, 0);
    lv_obj_align(s_widgets.clock, LV_ALIGN_CENTER, 0, 0);
}

static void update_state_screen(const app_state_snapshot_t *state)
{
    char text[128];
    set_icon_online_state(s_widgets.lan, state->wifi_connected);
    set_icon_online_state(s_widgets.mac, state->hosts[HOST_MAC].online);
    set_icon_online_state(s_widgets.windows, state->hosts[HOST_WINDOWS].online);

    const host_id_t visible_host = state->display_target;
    const host_status_t *host = &state->hosts[visible_host];
    label_set_text_if_changed(s_widgets.active_host,
                              visible_host == HOST_MAC ? "MAC" : "WIN");
    if (host->temperature_valid) {
        snprintf(text, sizeof(text), "%d", (int)host->cpu_temperature_c);
        label_set_text_if_changed(s_widgets.cpu, text);
    } else label_set_text_if_changed(s_widgets.cpu, "--");
    int memory_segments = 0;
    if (host->memory_valid) {
        const int memory_percent = (int)host->memory_percent;
        snprintf(text, sizeof(text), "%d%%", memory_percent);
        label_set_text_if_changed(s_widgets.memory, text);
        memory_segments = memory_percent > 0 ? (memory_percent + 4) / 5 : 0;
    } else {
        label_set_text_if_changed(s_widgets.memory, "--%");
    }
    if (memory_segments > 20) memory_segments = 20;
    for (int i = 0; i < 20; ++i) {
        set_bg_color_if_changed(s_widgets.memory_segments[i],
                                i < memory_segments ? 0x111111 : 0xffffff);
    }

    static const char *dashboard_titles[] = { "SYSTEM", "WEATHER", "MARKETS" };
    const uint8_t dashboard_page = state->data_window_index < 3 ? state->data_window_index : 0;
    label_set_text_if_changed(s_widgets.dashboard_title, dashboard_titles[dashboard_page]);
    for (int i = 0; i < 3; ++i) {
        if (i == dashboard_page) lv_obj_clear_flag(s_widgets.dashboard_pages[i], LV_OBJ_FLAG_HIDDEN);
        else lv_obj_add_flag(s_widgets.dashboard_pages[i], LV_OBJ_FLAG_HIDDEN);
    }

    static const char *modes[] = { "MANUAL", "STANDARD", "SILENT", "TURBO" };
    label_set_text_if_changed(s_widgets.cooler_mode, modes[state->thermal_mode]);
    if (state->thermal_mode == THERMAL_MANUAL) {
        label_set_text_if_changed(s_widgets.cooler_target, "--");
    } else {
        snprintf(text, sizeof(text), "%d", state->thermal_targets_c[state->thermal_mode]);
        label_set_text_if_changed(s_widgets.cooler_target, text);
    }
    if (state->cooler_state == COOLER_INITIALIZING) {
        label_set_text_if_changed(s_widgets.cooler_level, "...");
    } else if (state->cooler_state == COOLER_ERROR) {
        label_set_text_if_changed(s_widgets.cooler_level, "!");
    } else if (state->cooler_state == COOLER_OFF || state->cooler_level == 0) {
        label_set_text_if_changed(s_widgets.cooler_level, "-");
    } else {
        snprintf(text, sizeof(text), "%u", state->cooler_level);
        label_set_text_if_changed(s_widgets.cooler_level, text);
    }

    const bool kvm_error = state->kvm_phase == KVM_ERROR ||
                           state->command_error[0] != '\0';
    const bool ready = state->wifi_connected && host->online && !kvm_error &&
                       (state->kvm_phase == KVM_IDLE ||
                        state->kvm_phase == KVM_DISABLED_UNCONFIRMED_TIMING);
    if (kvm_error) {
        label_set_text_if_changed(s_widgets.health_mark, "X");
        set_text_color_if_changed(s_widgets.health_mark, 0xb73832);
        label_set_text_if_changed(s_widgets.health_text, "ERROR");
    } else if (ready) {
        label_set_text_if_changed(s_widgets.health_mark, "OK");
        set_text_color_if_changed(s_widgets.health_mark, 0x3f8f4d);
        label_set_text_if_changed(s_widgets.health_text, "READY");
    } else if (!state->wifi_connected || !host->online) {
        label_set_text_if_changed(s_widgets.health_mark, "...");
        set_text_color_if_changed(s_widgets.health_mark, 0xd17d22);
        label_set_text_if_changed(s_widgets.health_text, "WAITING");
    } else {
        label_set_text_if_changed(s_widgets.health_mark, ">");
        set_text_color_if_changed(s_widgets.health_mark, 0x376ca8);
        label_set_text_if_changed(s_widgets.health_text, phase_text(state->kvm_phase));
    }
    snprintf(text, sizeof(text), "IP %s", state->ip_address);
    label_set_text_if_changed(s_widgets.network, text);
    snprintf(text, sizeof(text), "DATA %s%s",
             state->dashboard_valid ? (state->dashboard_source == HOST_WINDOWS ? "WINDOWS" : "MAC") : "NONE",
             state->dashboard_stale ? " (STALE)" : "");
    label_set_text_if_changed(s_widgets.connections, text);
    if (state->command_error[0] != '\0') {
        snprintf(text, sizeof(text), "ERROR: %s", state->command_error);
        label_set_text_if_changed(s_widgets.error, text);
    } else if (state->kvm_phase == KVM_ERROR) {
        snprintf(text, sizeof(text), "ERROR: %s", state->last_message);
        label_set_text_if_changed(s_widgets.error, text);
    } else {
        label_set_text_if_changed(s_widgets.error,
            state->dashboard_error[0] != '\0' ? state->dashboard_error : "NO ERRORS");
    }

    static uint64_t rendered_dashboard_revision = UINT64_MAX;
    if (state->dashboard_revision != rendered_dashboard_revision) {
        rendered_dashboard_revision = state->dashboard_revision;
        if (state->weather.valid) {
            label_set_text_if_changed(s_widgets.weather_city, state->weather.city_name);
            snprintf(text, sizeof(text), "%d", state->weather.current.temperature_c);
            label_set_text_if_changed(s_widgets.weather_temperature, text);
            snprintf(text, sizeof(text), "%d/%d", state->weather.current.high_c,
                     state->weather.current.low_c);
            label_set_text_if_changed(s_widgets.weather_high_low, text);
            draw_weather_icon(s_widgets.weather_current_icon,
                              state->weather.current.weather_code,
                              state->weather.current.is_day);
            for (int i = 0; i < APP_WEATHER_DAILY_COUNT; ++i) {
                label_set_text_if_changed(s_widgets.weather_daily_day[i], state->weather.daily[i].day);
                snprintf(text, sizeof(text), "%d", state->weather.daily[i].high_c);
                label_set_text_if_changed(s_widgets.weather_daily_value[i], text);
                draw_weather_icon(s_widgets.weather_daily_icon[i],
                                  state->weather.daily[i].weather_code, true);
            }
            for (int i = 0; i < APP_WEATHER_HOURLY_COUNT; ++i) {
                snprintf(text, sizeof(text), "%02u", state->weather.hourly[i].hour);
                label_set_text_if_changed(s_widgets.weather_hour[i], text);
                snprintf(text, sizeof(text), "%d", state->weather.hourly[i].temperature_c);
                label_set_text_if_changed(s_widgets.weather_hour_temperature[i], text);
                draw_weather_icon(s_widgets.weather_hour_icon[i],
                                  state->weather.hourly[i].weather_code,
                                  state->weather.hourly[i].is_day);
            }
        } else {
            label_set_text_if_changed(s_widgets.weather_city, "NO WEATHER DATA");
        }
        if (state->markets.valid) {
            const market_quote_t quotes[] = { state->markets.btc_usdt,
                                              state->markets.doge_usdt,
                                              state->markets.usd_cny };
            for (int i = 0; i < 3; ++i) {
                if (i == 0) snprintf(text, sizeof(text), "%.0f", quotes[i].price);
                else if (i == 1) snprintf(text, sizeof(text), "%.5f", quotes[i].price);
                else snprintf(text, sizeof(text), "%.4f", quotes[i].price);
                label_set_text_if_changed(s_widgets.market_price[i], text);
                snprintf(text, sizeof(text), "%+.2f%%", quotes[i].change_percent);
                label_set_text_if_changed(s_widgets.market_change[i], text);
                set_text_color_if_changed(s_widgets.market_change[i],
                    quotes[i].change_percent >= 0 ? 0x3f8f4d : 0xb73832);
            }
        }
    }
}

static int64_t update_clock_screen(void)
{
    const time_t now = time(NULL);
    if (now < 1700000000) {
        label_set_text_if_changed(s_widgets.clock, "--:--");
        return 1000;
    }
    struct tm local_time;
    localtime_r(&now, &local_time);
    char text[6];
    strftime(text, sizeof(text), "%H:%M", &local_time);
    label_set_text_if_changed(s_widgets.clock, text);
    return (int64_t)(60 - local_time.tm_sec) * 1000;
}

static void ui_task(void *argument)
{
    (void)argument;
    setenv("TZ", "CST-8", 1);
    tzset();
    lv_init();
    lv_tick_set_cb(tick_ms);
    lv_display_t *display = NULL;
    esp_err_t result = lcd_lvgl_init(&display);
    if (result != ESP_OK) {
        ESP_LOGE(TAG, "Display initialization failed: %s", esp_err_to_name(result));
        vTaskDelete(NULL);
        return;
    }
    (void)display;
    lv_obj_t *boot_status = create_boot_screen();
    /* Flush the lightweight boot screen before enabling its backlight. */
    (void)lv_timer_handler();
    hardware_set_backlight(true);
    app_state_set_backlight(s_state, true);
    s_ready = true;

    uint64_t rendered_revision = 0;
    int64_t next_clock_refresh_ms = 0;
    bool main_screen_visible = false;
    for (;;) {
        const int64_t now_ms = esp_timer_get_time() / 1000;
        ui_command_t command;
        while (xQueueReceive(s_commands, &command, 0) == pdTRUE) {
            if (command.type == UI_COMMAND_BOOT_STATUS && !main_screen_visible) {
                lv_label_set_text(boot_status, command.text);
            } else if (command.type == UI_COMMAND_SHOW_MAIN && !main_screen_visible) {
                create_screen();
                main_screen_visible = true;
                rendered_revision = UINT64_MAX;
                next_clock_refresh_ms = 0;
            }
        }
        app_state_snapshot_t snapshot;
        if (main_screen_visible && app_state_get_snapshot(s_state, &snapshot)) {
            if (snapshot.revision != rendered_revision) {
                update_state_screen(&snapshot);
                rendered_revision = snapshot.revision;
            }
            if (now_ms >= next_clock_refresh_ms) {
                next_clock_refresh_ms = now_ms + update_clock_screen();
            }
        }
        uint32_t wait_ms = lv_timer_handler();
        if (wait_ms < 5) wait_ms = 5;
        if (wait_ms > 20) wait_ms = 20;
        vTaskDelay(pdMS_TO_TICKS(wait_ms));
    }
}

esp_err_t ui_start(app_state_t *state)
{
    if (state == NULL) return ESP_ERR_INVALID_ARG;
    if (s_task != NULL) return ESP_OK;
    s_state = state;
    s_ready = false;
    s_commands = xQueueCreate(4, sizeof(ui_command_t));
    if (s_commands == NULL) return ESP_ERR_NO_MEM;
    if (xTaskCreate(ui_task, "lvgl_ui", 8192, NULL, 5, &s_task) != pdPASS) {
        vQueueDelete(s_commands);
        s_commands = NULL;
        s_task = NULL;
        return ESP_ERR_NO_MEM;
    }
    return ESP_OK;
}

bool ui_wait_ready(uint32_t timeout_ms)
{
    const TickType_t deadline = xTaskGetTickCount() + pdMS_TO_TICKS(timeout_ms);
    while (!s_ready && xTaskGetTickCount() < deadline) {
        vTaskDelay(pdMS_TO_TICKS(10));
    }
    return s_ready;
}

esp_err_t ui_set_boot_status(const char *status)
{
    if (s_commands == NULL || status == NULL || status[0] == '\0') {
        return ESP_ERR_INVALID_STATE;
    }
    ui_command_t command = { .type = UI_COMMAND_BOOT_STATUS };
    snprintf(command.text, sizeof(command.text), "%s", status);
    return xQueueSend(s_commands, &command, pdMS_TO_TICKS(50)) == pdTRUE
        ? ESP_OK : ESP_ERR_TIMEOUT;
}

esp_err_t ui_show_main_screen(void)
{
    if (s_commands == NULL) return ESP_ERR_INVALID_STATE;
    const ui_command_t command = { .type = UI_COMMAND_SHOW_MAIN };
    return xQueueSend(s_commands, &command, pdMS_TO_TICKS(50)) == pdTRUE
        ? ESP_OK : ESP_ERR_TIMEOUT;
}
